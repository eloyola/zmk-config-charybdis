/* Combos - included inside / { } block */

combos {
    compatible = "zmk,combos";
    timeout-ms = <20>;
    require-prior-idle-ms = <250>;

    combo_studio_unlock {
        timeout-ms = <50>;
        key-positions = <53 54 55>;
        bindings = <&studio_unlock>;
    };

    combo_config {
        timeout-ms = <50>;
        key-positions = <50 51 52>;
        bindings = <&tog 6>;
    };

    combo_pointer {
        bindings = <&to 7>;
        key-positions = <51 52 55>;
    };
};
